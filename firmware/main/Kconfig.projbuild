## firmware/main/Kconfig.projbuild
```kconfig
menu "Project Configuration"
    config LED_GPIO
        int "LED GPIO"
        default 38
        help
            GPIO pin used by the LED.

    config MAX_LEDS
        int "MAX LEDS"
        default 1
        help
            Number of LEDs in the strip.

    config WIFI_SSID
        string "WiFi SSID"
        default "myssid"
        help
            SSID (network name) for the ESP to connect to.

    config WIFI_PASSWORD
        string "WiFi Password"
        default "mypassword"
        help
            WiFi password (WPA or WPA2) for the ESP to connect to.
endmenu
```
